## BSP/ucLinux24BSP/uClinux-dist/linux-2.4.x/drivers/mtd/nand/Config.in
```kconfig
# drivers/mtd/nand/Config.in

# $Id: Config.in,v 1.3 2007-07-31 03:38:17 andy Exp $

mainmenu_option next_comment

comment 'NAND Flash Device Drivers'

dep_tristate '  NAND Device Support' CONFIG_MTD_NAND $CONFIG_MTD
if [ "$CONFIG_MTD_NAND" = "y" -o "$CONFIG_MTD_NAND" = "m" ]; then
   bool '    Verify NAND page writes' CONFIG_MTD_NAND_VERIFY_WRITE
fi

if [ "$CONFIG_ARM" = "y" ]; then
   dep_tristate '  NAND Flash device on WINBOND board' CONFIG_MTD_NAND_WINBOND $CONFIG_MTD_NAND $CONFIG_ARCH_WINBOND
   if [ "$CONFIG_MTD_NAND_WINBOND" != "n" ]; then
                   choice 'NAND is to be used in the system' \
                   "128MB_2k_page_size       CONFIG_128MB_NAND\
                   32MB_512_page_size        CONFIG_32MB_NAND" 128MB_2k_page_size
   fi
      # NAND type must be set, makefile use this to decide which yaffs2 directory to link.
      if [ "$CONFIG_128MB_NAND" = "y" ]; then
         define_bool CONFIG_2K_PAGE_SIZE y
      fi
      if [ "$CONFIG_32MB_NAND" = "y" ]; then
         define_bool CONFIG_512B_PAGE_SIZE y
      fi   
   dep_tristate '  NAND Flash device on SPIA board' CONFIG_MTD_NAND_SPIA $CONFIG_MTD_NAND $CONFIG_ARCH_P720T
   dep_tristate '  NAND Flash device on TOTO board' CONFIG_MTD_NAND_TOTO $CONFIG_MTD_NAND $CONFIG_ARCH_OMAP
   dep_tristate '  SmartMedia Card on AUTCPU12 board' CONFIG_MTD_NAND_AUTCPU12 $CONFIG_MTD_NAND $CONFIG_ARCH_AUTCPU12
   dep_tristate '  NAND Flash device on EDP7312 board' CONFIG_MTD_NAND_EDB7312 $CONFIG_MTD_NAND $CONFIG_ARCH_EDB7312
fi

if [ "$CONFIG_MTD_DOC2001PLUS" = "y" -o "$CONFIG_MTD_DOC2001" = "y" -o "$CONFIG_MTD_DOC2000" = "y" -o "$CONFIG_MTD_NAND" = "y" ]; then
   define_bool CONFIG_MTD_NAND_IDS y
else
  if [ "$CONFIG_MTD_DOC2001PLUS" = "m" -o "$CONFIG_MTD_DOC2001" = "m" -o "$CONFIG_MTD_DOC2000" = "m" -o "$CONFIG_MTD_NAND" = "m" ]; then
     define_bool CONFIG_MTD_NAND_IDS m
  fi
fi

if [ "$CONFIG_TOSHIBA_RBTX4925" = "y" ]; then
   dep_tristate '  SmartMedia Card on Toshiba RBTX4925 reference board' CONFIG_MTD_NAND_TX4925NDFMC $CONFIG_MTD_NAND $CONFIG_TOSHIBA_RBTX4925_MPLEX_NAND
fi

if [ "$CONFIG_TOSHIBA_RBTX4938" = "y" ]; then
   dep_tristate '  NAND Flash device on Toshiba RBTX4938 reference board' CONFIG_MTD_NAND_TX4938NDFMC $CONFIG_MTD_NAND $CONFIG_TOSHIBA_RBTX4938_MPLEX_NAND
fi

if [ "$CONFIG_PPCHAMELEONEVB" = "y" ]; then
    dep_tristate '  NAND Flash device on PPChameleonEVB board' CONFIG_MTD_NAND_PPCHAMELEONEVB $CONFIG_MTD_NAND
fi

if [ "$CONFIG_SOC_AU1550" = "y" ]; then
   dep_tristate '  NAND Flash Driver for Au1550 controller' CONFIG_MTD_NAND_AU1550 $CONFIG_MTD_NAND 
fi

if [ "$CONFIG_SH_SOLUTION_ENGINE" = "y" ]; then
   dep_tristate '  Renesas Flash ROM 4-slot interface board (FROM_BOARD4)' CONFIG_MTD_NAND_RTC_FROM4 $CONFIG_MTD_NAND
fi

dep_tristate '  DiskOnChip 2000, Millennium and Millennium Plus (NAND reimplementation) (EXPERIMENTAL)' CONFIG_MTD_NAND_DISKONCHIP $CONFIG_MTD_NAND $CONFIG_EXPERIMENTAL
if [ "$CONFIG_MTD_NAND_DISKONCHIP" = "y" -o "$CONFIG_MTD_NAND_DISKONCHIP" = "m" ]; then
   bool '    Advanced detection options for DiskOnChip' CONFIG_MTD_NAND_DISKONCHIP_PROBE_ADVANCED
   hex  '    Physical address of DiskOnChip' CONFIG_MTD_NAND_DISKONCHIP_PROBE_ADDRESS 
   bool '    Probe high addresses' CONFIG_MTD_NAND_DISKONCHIP_PROBE_HIGH $CONFIG_MTD_NAND_DISKONCHIP_PROBE_ADVANCED
   bool '    Allow BBT write on DiskOnChip Millennium and 2000TSOP' CONFIG_MTD_NAND_DISKONCHIP_BBTWRITE
fi

endmenu
```

## BSP/ucLinux24BSP/uClinux-dist/linux-2.4.x/drivers/usb/wbusbd/Config.in
```kconfig
#
# Winbond W90N745 USB device configuration
#
mainmenu_option next_comment
comment 'Support for W90N745 USB Device 1.1'

dep_bool 'Support W90N745 USB Device' CONFIG_WINBOND_USBD $CONFIG_USB

   if [ "$CONFIG_WINBOND_USBD" = "y" ]; then
                   choice ' usbd function support' \
                   "VCOM         CONFIG_WINBOND_USBD_VCOM\
                    MASS        CONFIG_WINBOND_USBD_MASS" MASS
   fi


endmenu
```

## BSP/ucLinux24BSP/uClinux-dist/user/fs/Config.in
```kconfig
dep_tristate 'Journalling Flash File System (JFFS) support' CONFIG_JFFS_FS $CONFIG_MTD
if [ "$CONFIG_JFFS_FS" = "y" -o "$CONFIG_JFFS_FS" = "m" ] ; then
   int 'JFFS debugging verbosity (0 = quiet, 3 = noisy)' CONFIG_JFFS_FS_VERBOSE 0
   bool 'JFFS stats available in /proc filesystem' CONFIG_JFFS_PROC_FS
fi
dep_tristate 'Journalling Flash File System v2 (JFFS2) support' CONFIG_JFFS2_FS $CONFIG_MTD
if [ "$CONFIG_JFFS2_FS" = "y" -o "$CONFIG_JFFS2_FS" = "m" ] ; then
   int 'JFFS2 debugging verbosity (0 = quiet, 2 = noisy)' CONFIG_JFFS2_FS_DEBUG 0
   bool 'JFFS2 support for NAND chips' CONFIG_JFFS2_FS_NAND
   bool 'JFFS2 ZLIB compression support (recommended)' CONFIG_JFFS2_ZLIB
   bool 'JFFS2 RTIME compression support (recommended)' CONFIG_JFFS2_RTIME
   bool 'JFFS2 RUBIN compression support' CONFIG_JFFS2_RUBIN
   bool 'JFFS2 LZO compression support' CONFIG_JFFS2_LZO
   bool 'JFFS2 LZARI compression support' CONFIG_JFFS2_LZARI
   choice 'JFFS2 default compression mode' \
        "none                                   CONFIG_JFFS2_CMODE_NONE \
         priority                               CONFIG_JFFS2_CMODE_PRIORITY \
         size                                   CONFIG_JFFS2_CMODE_SIZE" priority

   bool 'JFFS2 proc interface support' CONFIG_JFFS2_PROC
fi
```

## BSP/ucLinux24BSP/uClinux-dist/user/fs/Kconfig
```kconfig
config JFFS_FS
	tristate "Journalling Flash File System (JFFS) support"
	depends on MTD
	help
	  JFFS is the Journaling Flash File System developed by Axis
	  Communications in Sweden, aimed at providing a crash/powerdown-safe
	  file system for disk-less embedded devices. Further information is
	  available at (<http://developer.axis.com/software/jffs/>).

config JFFS_FS_VERBOSE
	int "JFFS debugging verbosity (0 = quiet, 3 = noisy)"
	depends on JFFS_FS
	default "0"
	help
	  Determines the verbosity level of the JFFS debugging messages.

config JFFS_PROC_FS
	bool "JFFS stats available in /proc filesystem"
	depends on JFFS_FS && PROC_FS
	help
	  Enabling this option will cause statistics from mounted JFFS file systems
	  to be made available to the user in the /proc/fs/jffs/ directory.

config JFFS2_FS
	tristate "Journalling Flash File System v2 (JFFS2) support"
        select CRC32
	depends on MTD
	help
	  JFFS2 is the second generation of the Journalling Flash File System
	  for use on diskless embedded devices. It provides improved wear
	  levelling, compression and support for hard links. You cannot use
	  this on normal block devices, only on 'MTD' devices.

	  Further information on the design and implementation of JFFS2 is
	  available at <http://sources.redhat.com/jffs2/>.

config JFFS2_FS_DEBUG
	int "JFFS2 debugging verbosity (0 = quiet, 2 = noisy)"
	depends on JFFS2_FS
	default "0"
	help
	  This controls the amount of debugging messages produced by the JFFS2
	  code. Set it to zero for use in production systems. For evaluation,
	  testing and debugging, it's advisable to set it to one. This will
	  enable a few assertions and will print debugging messages at the
	  KERN_DEBUG loglevel, where they won't normally be visible. Level 2
	  is unlikely to be useful - it enables extra debugging in certain
	  areas which at one point needed debugging, but when the bugs were
	  located and fixed, the detailed messages were relegated to level 2.

	  If reporting bugs, please try to have available a full dump of the
	  messages at debug level 1 while the misbehaviour was occurring.

config JFFS2_FS_NAND
	bool "JFFS2 support for NAND flash (EXPERIMENTAL)"
	depends on JFFS2_FS && EXPERIMENTAL
	default n
	help
	  This enables the experimental support for NAND flash in JFFS2. NAND
	  is a newer type of flash chip design than the traditional NOR flash,
	  with higher density but a handful of characteristics which make it
	  more interesting for the file system to use. Support for NAND flash
	  is not yet complete and may corrupt data. For further information,
	  including a link to the mailing list where details of the remaining
	  work to be completed for NAND flash support can be found, see the 
	  JFFS2 web site at <http://sources.redhat.com/jffs2>.

	  Say 'N' unless you have NAND flash and you are willing to test and
	  develop JFFS2 support for it.

config JFFS2_COMPRESSION_OPTIONS
	bool "Advanced compression options for JFFS2"
	default n
	help
	  Enabling this option allows you to explicitly choose which
	  compression modules, if any, are enabled in JFFS2. Removing
	  compressors and mean you cannot read existing file systems,
	  and enabling experimental compressors can mean that you
	  write a file system which cannot be read by a standard kernel.

	  If unsure, you should _definitely_ say 'N'.

config JFFS2_ZLIB
	bool "JFFS2 ZLIB compression support" if JFFS2_COMPRESSION_OPTIONS
	select ZLIB_INFLATE
	select ZLIB_DEFLATE
	depends on JFFS2_FS
	default y
        help
          Zlib is designed to be a free, general-purpose, legally unencumbered,
          lossless data-compression library for use on virtually any computer 
          hardware and operating system. See http://www.gzip.org/zlib/ for
          further information.
          
          Say 'Y' if unsure.

config JFFS2_RTIME
	bool "JFFS2 RTIME compression support" if JFFS2_COMPRESSION_OPTIONS
	depends on JFFS2_FS
	default y
        help
          Rtime does manage to recompress already-compressed data. Say 'Y' if unsure.

config JFFS2_RUBIN
	bool "JFFS2 RUBIN compression support" if JFFS2_COMPRESSION_OPTIONS
	depends on JFFS2_FS
	default n
        help
          RUBINMIPS and DYNRUBIN compressors. Say 'N' if unsure.

choice
        prompt "JFFS2 default compression mode" if JFFS2_COMPRESSION_OPTIONS
        default JFFS2_CMODE_PRIORITY
        depends on JFFS2_FS
        help
          You can set here the default compression mode of JFFS2 from 
          the avaiable compression modes. Don't touch if unsure.

config JFFS2_CMODE_NONE
        bool "no compression"
        help
          Uses no compression.

config JFFS2_CMODE_PRIORITY
        bool "priority"
        help
          Tries the compressors in a predefinied order and chooses the first 
          successful one.

config JFFS2_CMODE_SIZE
        bool "size (EXPERIMENTAL)"
        help
          Tries all compressors and chooses the one which has the smallest 
          result.

endchoice
```

## BSP/ucLinux24BSP/uClinux-dist/user/fs/jffs2/defconfig
```kconfig
# $Id: defconfig,v 1.1.1.1 2006-07-11 09:31:07 andy Exp $

CONFIG_JFFS2_FS=m
ifdef NONAND
CONFIG_JFFS2_FS_NAND=n
else
CONFIG_JFFS2_FS_NAND=y
endif
```
